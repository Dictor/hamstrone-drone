## nuttx/apps/hamstrone/Kconfig
```kconfig
#
# For a description of the syntax of this configuration file,
# see the file kconfig-language.txt in the NuttX tools repository.
#

config HAMSTRONE
	tristate "hamstrone daemon"
	default n
	---help---
		Enable the hamstrone
```

## nuttx/apps/myapp/Kconfig
```kconfig
#
# For a description of the syntax of this configuration file,
# see the file kconfig-language.txt in the NuttX tools repository.
#

config MY_APP
	tristate "my app"
	default n
	---help---
		Enable the my app
```
